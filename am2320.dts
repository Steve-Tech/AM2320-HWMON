/dts-v1/;
/plugin/;
/ {
	fragment@0 {
		target = <&i2c1>;
		__overlay__ {
			#address-cells = <1>;
			#size-cells = <0>;
			status = "okay";

			am2320: am2320@5c {
				compatible = "aosong,am2320";
				reg = <0x5c>;
				status = "okay";
			};
		};
	};
};
